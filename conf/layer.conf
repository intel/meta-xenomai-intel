## conf/layer.conf
```bitbake
# We have a conf and classes directory, add to BBPATH
BBPATH =. "${LAYERDIR}:"

# We have recipes-* directories, add to BBFILES
BBFILES += "${LAYERDIR}/recipes-*/*/*.bb \
            ${LAYERDIR}/recipes-*/*/*.bbappend"

BBFILE_COLLECTIONS += "meta-xenomai"
BBFILE_PATTERN_meta-xenomai = "^${LAYERDIR}/"
BBFILE_PRIORITY_meta-xenomai = "6"

# This should only be incremented on significant changes that will
# cause compatibility issues with other layers
BBPATH .= ":${LAYERDIR}"
PREFERRED_PROVIDER_virtual = "linux-intel"

require conf/include/linux-intel-rt-cmdline.inc
```
